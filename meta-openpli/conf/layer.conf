## meta-openpli/conf/layer.conf
```bitbake
# We have a conf and classes directory, append to BBPATH
BBPATH .= ":${LAYERDIR}"

# We have a recipes directory, add to BBFILES
BBFILES += "${LAYERDIR}/recipes-*/*/*.bb ${LAYERDIR}/recipes-*/*/*.bbappend"

BBFILE_COLLECTIONS += "openpli-layer"
BBFILE_PATTERN_openpli-layer := "^${LAYERDIR}/"
BBFILE_PRIORITY_openpli-layer = "7"

OPENPLI_BASE := '${@os.path.normpath("${LAYERDIR}/../")}'
# Prevent current directory creeping into sstate objects. Otherwise, building
# in another TOPDIR will cause recipes using this variable to be rebuilt.
OPENPLI_BASE[vardepvalue] = 'meta-openpli'

# samba
PREFERRED_VERSION_samba = "3.%"
# ffmpeg
PREFERRED_VERSION_ffmpeg = "4.%"

PREFERRED_VERSION_python-websocket-client ?= "0.59.0"
PREFERRED_VERSION_python-libupnp ?= "1.6.x"

PREFERRED_PROVIDER_libfribidi = "libfribidi"

PREFERRED_PROVIDER_libav = "ffmpeg"
PREFERRED_PROVIDER_libid3tag = "libid3tag"

PREFERRED_PROVIDER_libcrypto = "openssl"
PREFERRED_PROVIDER_libssl = "openssl"
PREFERRED_PROVIDER_libtool ?= "libtool"
PREFERRED_PROVIDER_libtool-native ?= "libtool-native"

PREFERRED_PROVIDER_nodejs ?= "perl"
PREFERRED_PROVIDER_nodejs-native ?= "perl-native"

PREFERRED_PROVIDER_python-pycrypto ?= "python-pycryptodome"
PREFERRED_PROVIDER_python-yenc ?= "python-sabyenc"

LICENSE_PATH += "${LAYERDIR}/licenses"

LAYERSERIES_COMPAT_openpli-layer = "zeus"
```
